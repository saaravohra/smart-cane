/*
  v1.SmartCane_SensorCode_sv
  Author: Saara Vohra & Aleah Otero
  Project: Smart Cane

  This code incorporates the following sensors:
  
***** Vibration Emitter *****

  The Vibration Emitter feature consists of 4 vibration motors, which each has their own
  purpose. The Vibration Emitter is "turned on" by calling the function vibrationMotorFeature().
  This function houses the calls for each of the three Vibration Emitter sub-features. 
  
  The first sub-feature is walkingDirection(rightTurn, leftTurn). This function will take in the parameters
  from the GPS Walking Directions which will indicate to the user whether they need to take a right
  or left turn. Based on which boolean variable, rightTurn or leftTurn, is true, it will check what 
  the user's dominant hand is, right or left, and then send either the thumb or pinky vibration motor
  a 3 second vibration pulse of 30% dutycyle strength to the corresponding finger motor.
  
  The vibration pulse is created using the function vibrateMotor() which will create 2 analogWrite calls
  to the respective finger motor, one that "turns on" the vibration pulse, and one that "turns off" the
  vibration pulse. 
  
  The second sub-feature is pathObstruction(obstruction). This function takes in the String parameter obstruction,
  which will be sent in by the ultrasonic sensor, indicating what type of obstacle is obstructing the user's 
  path. Based on what the obstruction is, the function setVibrationPattern() will be called, which creates the 
  braille pattern representation of the first/first two letter/letters of the obstruction. This braille pattern 
  will be sent as six - 1 second vibration pulses of 20% or 30% dutycycle strength to the pointer finger motor. 
  The 30% strength is sent for the positions of the braille letter representation that are raised. The 20% strength 
  is sent for the positions of the braille letter representation that are not raised.
  
  The third sub-feature, objectDistance(distance), works in tandem with the second sub-feature. This function takes in
  the parameter int parameter distance, which will be sent in by the ultrasonic sensor, indicating the amount of distance
  between the user and the obstruction in their walking path. Based on the distance, greater than 10 feet, between 10 and 5
  feet and less than five feet (but greater than 1 foot away), the user will feel a 3 second pulse in the middle finger motor
  of varying dutycycle strengths relative to their distance away from the obstruction. If greater than 10 feet away, the user
  will feel no vibration pulse. If the obstruction is 10 feet away, the user will feel a vibration pulse of 20% dutycycle. 
  If the obstruction is between 5 and 10 feet away, the user will feel a 30% strength pulse. If the obstruction is less than
  5 feet away, the user will feel a 40% strength vibration pulse to their middle finger. 
  
  Once the three sub-feature's functions have been called the Vibration Emitter feature will "turn off" until a change occurs
  and the code is called again.
  

***** FingerPrint Sensor *****

  When the user presses their finger on the Touch Sensor, the boolean variable, userLogin,
  will update to TRUE. When the user presses their finger to the Touch Sensor the next time,
  the userLogin variable will be set to FALSE. When userLogin is FALSE, (defualt state)
  the SmartCane will not call any other code, and as a result "turn off" the other Smart Cane
  functionalities. 
  
  The code is located in the loop() function. This is because the login status needs to 
  constantly be checked to see if the user logs in or out of the cane.
  
  **NOTE: The user cannot "log out" of the Smart Cane during a walking trip. They must wait until
  the walking trip is over to do so. Attempting to "log out" of the Smart Cane by pressing their 
  finger to the Touch Sensor will not turn off the Vibration Emitter function if it has already been
  turned on. 
  
  
  ***** Ultrasonic Sensor *****
  

*/

// VIBRATION EMITTER VARIABLES
// Duty Cycles
const int tenPercent = 26;
const int twentyPercent = 51;
const int thirtyPercent = 77;
const int fourtyPercent = 102;
const int fiftyPercent = 128;

// Delay Times
const int oneSec = 1000;
const int twoSec = 2000;
const int threeSec = 3000;
const int fourSec = 4000;
const int fiveSec = 5000;
const int sixSec = 6000;
const int sevenSec = 7000;
const int eightSec = 8000;
const int nineSec = 9000;
const int tenSec = 10000;

// Obstruction Patterns
const int dcTopLeft = 0;
const int dcTopRight = 0;
const int dcMiddleLeft = 0;
const int dcMiddleRight = 0;
const int dcBottomLeft = 0;
const int dcBottomRight = 0;

// Inputs
const int thumb = 11;
const int pointer = 10;
const int middle = 9;
const int pinky = 6;

// User's Dominant Hand
// Default: The user is right handed
const bool rightHanded = true;

/* FINGERPRINT SENSOR DRIVEN VARIABLES
  userLogin: When the user presses their finger on the FingerPrint sensor, the variable
  will update to true. When the user presses their finger to the FingerPrint sensor the
  next time, it will turn off the SmartCane functionalities.
*/
// Input
const int touchSensor = 5;

bool userLogin = false;
unsigned long previousMillis = 0;
unsigned long elapsedMillis = 0;
int ledState = LOW;
int debounceTime = 1000;

/* ULTRASONIC SENSOR DRIVEN VARIABLES

*/
// TODO: This will eventually be fed in by the ultrasonic sensor
const String obstruction = "vehicle"; //pedestrian, pole, vehicle, curb, door opening
const int distance = 2; //starts to buzz when object is 10 feet or closer

/* GPS/WALKING DIRECTION DRIVEN VARIABLES

*/
// TODO: These will eventually be fed in by the walking directions
const bool rightTurn = false;
const bool leftTurn = true;

void setup() {

  // Vibration Motors
  pinMode (thumb, OUTPUT);
  pinMode (pointer, OUTPUT);
  pinMode (middle, OUTPUT);
  pinMode (pinky, OUTPUT);

  // FingerPrint Sensor
  pinMode(touchSensor, INPUT);
  pinMode(LED_BUILTIN, OUTPUT);
  digitalWrite(LED_BUILTIN, LOW);

  // To see serial outputs in serial monitor
  Serial.begin(9600);

  // TEST FUNCTION: To test the vibration motors to make sure they are working properly.
  //motorTest();
  
}

// FingerPrint Sensor Code
void loop() {
  elapsedMillis = millis() - previousMillis;
  if (digitalRead(touchSensor) == HIGH && elapsedMillis > debounceTime) {
    if (ledState == HIGH) {
      userLogin = false;
      ledState = LOW;
    } 
    else {
      userLogin = true;
      ledState = HIGH;
    }
    digitalWrite(LED_BUILTIN, ledState);
    Serial.println(userLogin ? "The user has logged in to the Smart Cane." : "The user has logged out of the Smart Cane.");
    
  if (userLogin) {
    Serial.println("Start Vibration Emitter Feature.");
    vibrationMotorFeature();
  }
  else {
    Serial.println("Smart Cane features cannot be used until the user logs in.");
  }
    
  previousMillis = millis();
  };
}

// End of FingerPrint Sensor Code

// Vibration Motor Code
void vibrationMotorFeature() {
  Serial.println("Vibration Emitters have been turned on.");
  delay(threeSec); //For testing purposes
  walkingDirection(rightTurn, leftTurn);
  pathObstruction(obstruction);
  objectDistance(distance);
  Serial.println("Vibration Emitters have been turned off.");
}

void motorTest() { //To test that the motors are functioning properly
  Serial.println("Begin finger motor tests.");
  Serial.println("Thumb motor");
  vibrateMotor(thumb, fiftyPercent, threeSec, 0, threeSec);
  Serial.println("Pointer finger motor");
  vibrateMotor(pointer, fiftyPercent, threeSec, 0, threeSec);
  Serial.println("Middle finger motor");
  vibrateMotor(middle, fiftyPercent, threeSec, 0, threeSec);
  Serial.println("Pinky finger motor");
  vibrateMotor(pinky, fiftyPercent, threeSec, 0, threeSec);
  Serial.println("Finger motor tests complete.");
}

void vibrateMotor(int pin, int dutyCycleOn, int delayTimeOn, int dutyCycleOff, int delayTimeOff) {
  analogWrite (pin, dutyCycleOn);
  delay(delayTimeOn);

  analogWrite (pin, dutyCycleOff);
  delay(delayTimeOff);
}

//buzz for 3 seconds, 30% for both right and left turn
void walkingDirection(bool rightTurn, bool leftTurn) {
  if (rightTurn) {
    Serial.println("The user needs to take a right turn to follow the GPS directions.");
    if (rightHanded) {
      Serial.println("The user is right handed.");
      vibrateMotor(pinky, thirtyPercent, threeSec, 0, threeSec);
    }
    else { //leftHanded
      Serial.println("The user is left handed.");
      vibrateMotor(thumb, thirtyPercent, threeSec, 0, threeSec);
    }
  }
  else if (leftTurn) {
    Serial.println("The user needs to take a left turn to follow the GPS directions.");
    if (rightHanded) {
      Serial.println("The user is right handed.");
      vibrateMotor(thumb, thirtyPercent, threeSec, 0, threeSec);
    }
    else { //leftHanded
      Serial.println("The user is left handed.");
      vibrateMotor(pinky, thirtyPercent, threeSec, 0, threeSec);
    }
  }
  else { //The user does not need to turn
    Serial.println("The user does not need to turn to follow the GPS directions.");
  }
}

void setVibrationPattern(int dcTopLeft, int dcTopRight, int dcMiddleLeft, int dcMiddleRight, int dcBottomLeft, int dcBottomRight) {
  //top left
  //vibrateMotor(pointer, dcTopLeft, oneSec, 0, oneSec);
  analogWrite (pointer, dcTopLeft);
  delay(oneSec);
  analogWrite (pointer, 0);
  delay(oneSec);

  //top right
  //vibrateMotor(pointer, dcTopRight, oneSec, 0, oneSec);
  analogWrite (pointer, dcTopRight);
  delay(oneSec);
  analogWrite (pointer, 0);
  delay(oneSec);

  //middle left
  //vibrateMotor(pointer, dcMiddleLeft, oneSec, 0, oneSec);
  analogWrite (pointer, dcMiddleLeft);
  delay(oneSec);
  analogWrite (pointer, 0);
  delay(oneSec);

  //middle right
  //vibrateMotor(pointer, dcMiddleRight, oneSec, 0, oneSec);
  analogWrite (pointer, dcMiddleRight);
  delay(oneSec);
  analogWrite (pointer, 0);
  delay(oneSec);

  //bottom left
  //vibrateMotor(pointer, dcBottomLeft, oneSec, 0, oneSec);
  analogWrite (pointer, dcBottomLeft);
  delay(oneSec);
  analogWrite (pointer, 0);
  delay(oneSec);

  //bottom right
  //vibrateMotor(pointer, dcBottomRight, oneSec, 0, oneSec);
  analogWrite (pointer, dcBottomRight);
  delay(oneSec);
  analogWrite (pointer, 0);
  delay(oneSec);
}

int pathObstruction(String obstruction) {
  //20% for empty slot, 30% for raised
  if (obstruction != "") {
    Serial.println("There is a " + obstruction + " obstructing the user's path.");
  }
  if (obstruction == "curb") {
    setVibrationPattern(thirtyPercent, thirtyPercent, twentyPercent, twentyPercent, twentyPercent, twentyPercent); //C
  }
  else if (obstruction == "door opening") {
    setVibrationPattern(thirtyPercent, thirtyPercent, twentyPercent, thirtyPercent, twentyPercent, twentyPercent); //D
  }
  else if (obstruction == "pedestrian") {
    setVibrationPattern(thirtyPercent, thirtyPercent, thirtyPercent, twentyPercent, thirtyPercent, twentyPercent); //P
    setVibrationPattern(thirtyPercent, twentyPercent, twentyPercent, thirtyPercent, twentyPercent, twentyPercent); //E
  }
  else if (obstruction == "pole") {
    setVibrationPattern(thirtyPercent, thirtyPercent, thirtyPercent, twentyPercent, thirtyPercent, twentyPercent); //P
    setVibrationPattern(thirtyPercent, twentyPercent, thirtyPercent, twentyPercent, thirtyPercent, twentyPercent); //O
  }
  else if (obstruction == "vehicle") {
    setVibrationPattern(thirtyPercent, twentyPercent, thirtyPercent, twentyPercent, thirtyPercent, thirtyPercent); //V
  }
  else {
    Serial.println("There is no object obstructing the user's path.");
  }
}

// TODO: Decide the distance values that will be checked once the ultrasonic sensors are
//       implemented
void objectDistance(int distance) {
  if (distance == 100) {
    Serial.println("The object is about 100 cm away from the user.");
    analogWrite (middle, twentyPercent); //TODO:chnage it here to vibration motor!!
    delay(threeSec);
    analogWrite (middle, 0);
  }
  else if ((distance < 20) && (distance >= 4)) {
    Serial.println("The object is between 4 and 20 cm away from the user.");
    analogWrite (middle, thirtyPercent);
    delay(threeSec);
    analogWrite (middle, 0);
  }
  else if ((distance < 4) && (distance >= 1)) {
    Serial.println("The object is about less than 4 cm away from the user.");
    analogWrite (middle, fourtyPercent);
    delay(threeSec);
    analogWrite (middle, 0);
  }
  else {
    Serial.println("There is no object close to the user.");
  }
}

// End of Vibration Motor Code