/*
v1.Vibration Emitter Feature Code
Author: Saara Vohra
Project: Smart Cane
**Prior to incorporating other features to the board**
*/

// Duty Cycles 
const int tenPercent = 26;
const int twentyPercent = 51;
const int thirtyPercent = 77;
const int fourtyPercent = 102;
const int fiftyPercent = 128;

// Delay Times
const int oneSec = 1000;
const int twoSec = 2000;
const int threeSec = 3000;
const int fourSec = 4000;
const int fiveSec = 5000;
const int sixSec = 6000;
const int sevenSec = 7000;
const int eightSec = 8000;
const int nineSec = 9000;
const int tenSec = 10000;

// Obstruction Patterns
const int dcTopLeft = 0;
const int dcTopRight = 0;
const int dcMiddleLeft = 0;
const int dcMiddleRight = 0;
const int dcBottomLeft = 0;
const int dcBottomRight = 0;

// Inputs
const int thumb = 11;
const int pointer = 10; 
const int middle = 9;
const int pinky = 6;

// User's dominant hand
// Default: The user is right handed
const bool rightHanded = true;


const bool loginSuccessful = false;

// TODO: This will eventually be fed in by the ultrasonic sensor
const String obstruction = "vehicle"; //pedestrian, pole, vehicle, curb, door opening
const int distance = 2; //starts to buzz when object is 10 feet or closer

// TODO: These will eventually be fed in by the walking directions
const bool rightTurn = false;
const bool leftTurn = false;

void setup() {
  
  // Vibration Emitter
  pinMode (thumb, OUTPUT);
  pinMode (pointer, OUTPUT);
  pinMode (middle, OUTPUT);
  pinMode (pinky, OUTPUT);
  
  // To see serial outputs in serial monitor
  Serial.begin(9600);
  
  //motorTest(); //To test the motors to make sure they are working properly
  if(loginSuccessful){
    Serial.println("Smart Cane user login successful!");
    vibrationMotorFeature();
  }
  else{
    Serial.println("The wrong user is trying to log in to the Smart Cane.");
  }
  
}

void vibrationMotorFeature(){
  Serial.println("Vibration Emitters have been turned on.");
  walkingDirection(rightTurn, leftTurn);
  pathObstruction(obstruction);
  objectDistance(distance);
  Serial.println("Vibration Emitters have been turned off.");
}

void motorTest(){ //To test that the motors are functioning properly
  Serial.println("Begin finger motor tests.");
  Serial.println("Thumb motor");
  vibrateMotor(thumb, fiftyPercent, threeSec, 0, threeSec);
  Serial.println("Pointer finger motor");
  vibrateMotor(pointer, fiftyPercent, threeSec, 0, threeSec);
  Serial.println("Middle finger motor");
  vibrateMotor(middle, fiftyPercent, threeSec, 0, threeSec);
  Serial.println("Pinky finger motor");
  vibrateMotor(pinky, fiftyPercent, threeSec, 0, threeSec);
  Serial.println("Finger motor tests complete.");
}

void loop() {
}

void vibrateMotor(int pin, int dutyCycleOn, int delayTimeOn, int dutyCycleOff, int delayTimeOff){
  analogWrite (pin, dutyCycleOn);
  delay(delayTimeOn);
 
  analogWrite (pin, dutyCycleOff);
  delay(delayTimeOff);
}

void setVibrationPattern(int dcTopLeft, int dcTopRight, int dcMiddleLeft, int dcMiddleRight, int dcBottomLeft, int dcBottomRight){ 
  //top left
  analogWrite (pointer, dcTopLeft);
  delay(oneSec);
  analogWrite (pointer, 0);
  delay(oneSec);
  
  //top right
  analogWrite (pointer, dcTopRight);
  delay(oneSec);
  analogWrite (pointer, 0);
  delay(oneSec);
  
  //middle left
  analogWrite (pointer, dcMiddleLeft);
  delay(oneSec);
  analogWrite (pointer, 0);
  delay(oneSec);
  
  //middle right
  analogWrite (pointer, dcMiddleRight);
  delay(oneSec);
  analogWrite (pointer, 0);
  delay(oneSec);
  
  //bottom left
  analogWrite (pointer, dcBottomLeft);
  delay(oneSec);
  analogWrite (pointer, 0);
  delay(oneSec);
  
  //bottom right
  analogWrite (pointer, dcBottomRight);
  delay(oneSec);
  analogWrite (pointer, 0);
  delay(oneSec);
}

//buzz for 3 seconds, 30% for both right and left turn
void walkingDirection(bool rightTurn, bool leftTurn){  
  if(rightTurn){
    Serial.println("The user needs to take a right turn to follow the GPS directions.");
    if(rightHanded){
      Serial.println("The user is right handed.");
      vibrateMotor(pinky, thirtyPercent, threeSec, 0, threeSec);
    }
    else{ //leftHanded
      Serial.println("The user is left handed.");
      vibrateMotor(thumb, thirtyPercent, threeSec, 0, threeSec);
    }
  }
  else if(leftTurn){
    Serial.println("The user needs to take a left turn to follow the GPS directions.");
    if(rightHanded){
      Serial.println("The user is right handed.");
      vibrateMotor(thumb, thirtyPercent, threeSec, 0, threeSec);
    }
    else{ //leftHanded
      Serial.println("The user is left handed.");
      vibrateMotor(pinky, thirtyPercent, threeSec, 0, threeSec);
    }
  }
  else{ //The user does not need to turn 
    Serial.println("The user does not need to turn to follow the GPS directions.");
  } 
}

int pathObstruction(String obstruction){
  //20% for empty slot, 30% for raised
  if(obstruction != ""){
    Serial.println("There is a " + obstruction + " obstructing the user's path.");
  }

  if(obstruction == "curb"){
    setVibrationPattern(thirtyPercent, thirtyPercent, twentyPercent, twentyPercent, twentyPercent, twentyPercent); //C
  }
  else if(obstruction == "door opening"){
    setVibrationPattern(thirtyPercent, thirtyPercent, twentyPercent, thirtyPercent, twentyPercent, twentyPercent); //D
  }
  else if(obstruction == "pedestrian"){
    setVibrationPattern(thirtyPercent, thirtyPercent, thirtyPercent, twentyPercent, thirtyPercent, twentyPercent); //P
    setVibrationPattern(thirtyPercent, twentyPercent, twentyPercent, thirtyPercent, twentyPercent, twentyPercent); //E
  }
  else if(obstruction == "pole"){
    setVibrationPattern(thirtyPercent, thirtyPercent, thirtyPercent, twentyPercent, thirtyPercent, twentyPercent); //P
    setVibrationPattern(thirtyPercent, twentyPercent, thirtyPercent, twentyPercent, thirtyPercent, twentyPercent); //O
  }
  else if(obstruction == "vehicle"){
    setVibrationPattern(thirtyPercent, twentyPercent, thirtyPercent, twentyPercent, thirtyPercent, thirtyPercent); //V
  }
  else{
    Serial.println("There is no object obstructing the user's path.");
  }
}

// TODO: Decide the distance values that will be checked once the ultrasonic sensors are 
//       implemented
void objectDistance(int distance){
  if(distance == 10){
    Serial.println("The object is about 10 feet away from the user.");
    analogWrite (middle, twentyPercent);
    delay(threeSec);
    analogWrite (middle, 0);
  }
  else if((distance < 10) && (distance >= 5)){
    Serial.println("The object is between 5 and 10 feet away from the user.");
    analogWrite (middle, thirtyPercent);
    delay(threeSec);
    analogWrite (middle, 0);
  }
  else if((distance < 5) && (distance >= 1)){
    Serial.println("The object is about less than 5 feet away from the user.");
    analogWrite (middle, fourtyPercent);
    delay(threeSec);
    analogWrite (middle, 0);
  }
  else{
    Serial.println("There is no object close to the user.");
  }
}
